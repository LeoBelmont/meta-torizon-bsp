## conf/machine/include/agx-thor-torizon.inc
```bitbake
require tegra-torizon.inc

TEGRA_TORIZON_CONSOLE = "earlycon=tegra_utc,mmio32,0xc5a0000 console=ttyUTC0,115200"
```

## conf/machine/include/jetson-orin-nano-devkit.inc
```bitbake
require tegra-torizon.inc

IMAGE_INSTALL:append:tegra = " nvidia-torizon-runtime nvidia-drm-loadconf"

IMAGE_INSTALL:remove:pn-torizon-minimal = " nvidia-torizon-runtime"
```
